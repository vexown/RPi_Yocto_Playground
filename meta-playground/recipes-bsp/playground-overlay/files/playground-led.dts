/*
 * playground-led.dts — our first device tree OVERLAY.
 *
 * An overlay is a tree FRAGMENT grafted onto the base device tree at
 * boot (by the Pi firmware, when config.txt says dtoverlay=playground-led).
 * The base tree describes the board as shipped; overlays describe what
 * YOU added — exactly the tool for "I wired a sensor/LED to the header".
 *
 * This one declares an LED on GPIO17 (physical pin 11). The claim is
 * bold: the kernel will create /sys/class/leds/playground whether or
 * not a physical LED is wired there — Linux believes the tree, not the
 * copper. (Wire pin 11 -> LED -> ~330R -> GND (pin 9) to see it blink
 * for real. Active-high: pin drives the LED.)
 *
 * Reference: the stock overlays in the kernel source,
 * arch/arm/boot/dts/overlays/gpio-led-overlay.dts. We deliberately DROP
 * its pinctrl fragment: those brcm,pins properties are bcm283x pinmux
 * dialect, and on the Pi 5 the header pins hang off the RP1 chip, which
 * speaks a different pinctrl binding. Not needed anyway — the leds-gpio
 * driver requests the pin via gpiolib and sets it output itself.
 */

/dts-v1/;
/plugin/;	/* THIS makes it an overlay: dtc emits a __fixups__ section
		   so references to labels that don't exist in this file
		   (like &gpio below) can be resolved at graft time against
		   the base tree's __symbols__ table. */

/ {
	/* Which base trees we claim to fit. The firmware doesn't enforce
	   this strictly, but be honest: we wrote this for the Pi 5. */
	compatible = "brcm,bcm2712";

	fragment@0 {
		target-path = "/";	/* graft point: the root of the base tree */
		__overlay__ {
			playground_leds: playground-leds {
				/* Matchmaking key: this string is what makes the
				   kernel bind its leds-gpio driver to our node. */
				compatible = "gpio-leds";

				led_playground: led-playground {
					label = "playground";	/* -> /sys/class/leds/playground */

					/* <controller pin flags>: &gpio is resolved at
					   load time; on the Pi 5 the base dts aliases
					   gpio -> rp1_gpio (bcm2712-rpi-5-b.dts:236),
					   because the RP1 south-bridge owns the 40-pin
					   header. 17 = GPIO17, 0 = active-high. */
					gpios = <&gpio 17 0>;

					/* Default trigger "timer" = 500ms on/off blink
					   from the moment the driver binds — proof of
					   life with zero userspace involvement. Change
					   it at runtime via .../playground/trigger. */
					linux,default-trigger = "timer";
				};
			};
		};
	};
};
