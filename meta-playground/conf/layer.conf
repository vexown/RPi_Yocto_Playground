## meta-playground/conf/layer.conf
```bitbake
# layer.conf — the layer's "passport". BitBake reads this for every layer
# listed in bblayers.conf, before parsing any recipes. Everything below was
# generated by `bitbake-layers create-layer`; comments are ours.

# BBPATH is like $PATH but for metadata: where BitBake looks for conf files
# and classes. ".=" appends WITHOUT a space (it's path-colon-joined).
# ${LAYERDIR} = the directory containing this file, resolved at parse time.
BBPATH .= ":${LAYERDIR}"

# Which files in this layer are recipes. This glob is why the standard
# layout is recipes-<group>/<recipename>/<recipename>_<version>.bb —
# a recipe placed elsewhere simply won't be found.
BBFILES += "${LAYERDIR}/recipes-*/*/*.bb \
            ${LAYERDIR}/recipes-*/*/*.bbappend"

# Registers the layer under a collection name, and maps which files belong
# to it (any file under LAYERDIR). The name is what LAYERDEPENDS elsewhere
# can refer to.
BBFILE_COLLECTIONS += "meta-playground"
BBFILE_PATTERN_meta-playground = "^${LAYERDIR}/"

# If two layers provide the SAME recipe (same name+version), higher priority
# wins. Also decides bbappend application order. poky's meta is 5,
# meta-raspberrypi is 9 — we sit between them at the default 6.
BBFILE_PRIORITY_meta-playground = "6"

# We need poky's core layer (that's meta's collection name) to exist.
LAYERDEPENDS_meta-playground = "core"

# Compatibility declaration: "this layer is written for scarthgap".
# On upgrade to a newer Yocto, builds fail until someone reviews the layer
# and updates this — a deliberate speed bump, not bureaucracy.
LAYERSERIES_COMPAT_meta-playground = "scarthgap"
```
